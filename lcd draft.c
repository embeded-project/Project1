#include "stdint.h"
#include "C:/Keil/EE319Kware/inc/tm4c123gh6pm.h"
#include "TM4C123GH6pm.h"
void SystemInit () {}
void LCD_Command (char com)
{
	uint32_t delay;
	GPIO_PORTD_DATA_R =0; // RS=0 , RW=0  
	GPIO_PORTB_DATA_R =com; 
  GPIO_PORTD_DATA_R |=04;	 //E=1
	delay=1;
	GPIO_PORTD_DATA_R =0;
	
}
void LCD_DATA(char data)
{
	uint32_t delay;
	GPIO_PORTD_DATA_R =0x01; // RS=1 , RW=0  
	GPIO_PORTB_DATA_R =data; 
  GPIO_PORTD_DATA_R |=04;	 //E=1
	delay=1;
	GPIO_PORTD_DATA_R =0;

}
void init ()
{
	uint32_t delay;
	SYSCTL_RCGCGPIO_R |= 0x20; //portf
	delay=1; //dummy var
	GPIO_PORTF_LOCK_R=0x4C4F434B;  
	GPIO_PORTF_CR_R = 0x1F;  //enable bins 0.1.2.3.4
	GPIO_PORTF_AMSEL_R =0;    
	GPIO_PORTF_PCTL_R =0;
	GPIO_PORTF_AFSEL_R =0;
	GPIO_PORTF_DIR_R =0x0E;  //switches=0 inputs , leds=1 outputs
	GPIO_PORTF_DEN_R =0x1F;
	GPIO_PORTF_PUR_R=0x11;    
	
	SYSCTL_RCGCGPIO_R |= 0x0A; //port B,D
	GPIO_PORTB_LOCK_R=0x4C4F434B;  
	GPIO_PORTD_LOCK_R=0x4C4F434B;
	GPIO_PORTB_CR_R = 0xFF;  //enable all bins of B
	GPIO_PORTD_CR_R = 0x07;  //enable bins 0,1,2 of D
	GPIO_PORTB_AMSEL_R =0;    
	GPIO_PORTB_PCTL_R =0;
	GPIO_PORTB_AFSEL_R =0;
	GPIO_PORTD_AMSEL_R =0;    
	GPIO_PORTD_PCTL_R =0;
	GPIO_PORTD_AFSEL_R =0;
	GPIO_PORTB_DIR_R =0xFF;  // all bins outputs
	GPIO_PORTD_DIR_R =0x07;  // bins 0,1,2 outputs
	GPIO_PORTB_DEN_R =0xFF; 
	GPIO_PORTD_DEN_R =0x07;
	 
}

int main()
{
	init();
	while(1)
	{
		if((GPIO_PORTF_DATA_R&0x11) == 0x10) //sw2 pin 0
		{
			GPIO_PORTF_DATA_R = 0x02;   //red led
		}
		else if((GPIO_PORTF_DATA_R&0x11) == 0x01)  //sw1 pin4
		{
			GPIO_PORTF_DATA_R = 0x04;   //blue led
		}
			
		else if((GPIO_PORTF_DATA_R&0x11) == 0x00) //2sw
		{
			GPIO_PORTF_DATA_R = 0x08;   //green led
		}
		else
		{
			GPIO_PORTF_DATA_R = 0;			
		}
		
	}
	while (1)
	{
		LCD_Command(0x30);   //wakeup
		LCD_Command(0x01);  //clear screen
		LCD_Command(0x38);    //8 bit data
		LCD_Command(0x06);    // increment cursor (shift it to right)
		LCD_Command(0x0f);    // diplay on 
		LCD_DATA ('A');
		
	}



}
	